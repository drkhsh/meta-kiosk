## conf/layer.conf
```bitbake
# We have a conf and classes directory, add to BBPATH
BBPATH .= ":${LAYERDIR}"

# We have recipes-* directories, add to BBFILES
BBFILES += "${LAYERDIR}/recipes-*/*/*.bb \
            ${LAYERDIR}/recipes-*/*/*.bbappend"

BBFILE_COLLECTIONS += "meta-kiosk"
BBFILE_PATTERN_meta-kiosk = "^${LAYERDIR}/"
BBFILE_PRIORITY_meta-kiosk = "6"

LAYERDEPENDS_meta-kiosk = "core"
LAYERSERIES_COMPAT_meta-kiosk = "scarthgap"
```
